/* source key position labels */
#include "zmk-helpers/key-labels/hillside52.h"

/* map Zen's extra keys */
#define X_LT &none
#define X_RT &none
#define X_LM &none
#define X_RM &none
#define X_LB &none
#define X_MB &none &none
#define X_RB &none
#define X_LH &none &none &none &none
#define X_MH &none &none
#define X_RH &none &none &none &none

/* activate bluetooth */
#define CONFIG_WIRELESS 1

/* source the main keymap */
#include "base.keymap"
